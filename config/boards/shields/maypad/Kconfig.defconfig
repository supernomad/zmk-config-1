## config/boards/shields/sofle-rgb/Kconfig.defconfig
```kconfig
if SHIELD_SOFLE_RGB_LEFT

config ZMK_KEYBOARD_NAME
       default "Sofle RGB Left"

config ZMK_SPLIT_BLE_ROLE_CENTRAL
       deafult y

endif

if SHIELD_SOFLE_RGB_RIGHT

config ZMK_KEYBOARD_NAME
       default "Sofle RGB Right"

endif

if SHIELD_SOFLE_RGB_LEFT || SHIELD_SOFLE_RGB_RIGHT

config ZMK_SPLIT
       default y

endif
```

## config/boards/shields/sofle_rgb/Kconfig.shield
```kconfig
config SHIELD_SOFLE_RGB_LEFT
       def_bool $(shields_list_contains,sofle_rgb_left)

config SHIELD_SOFLE_RGB_RIGHT
       def_bool $(shields_list_contains,sofle_rgb_right)
```
