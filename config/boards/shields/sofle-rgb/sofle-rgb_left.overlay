#include "sofle-rgb.dtsi"

&kscan0 {
  col-gpios
    = <&pro_micro_a 1 GPIO_ACTIVE_HIGH>
    , <&pro_micro_a 0 GPIO_ACTIVE_HIGH>
    , <&pro_micro_a 15 GPIO_ACTIVE_HIGH>
    , <&pro_micro_a 14 GPIO_ACTIVE_HIGH>
    , <&pro_micro_a 16 GPIO_ACTIVE_HIGH>
    , <&pro_micro_a 10 GPIO_ACTIVE_HIGH>
    ;
};

&left_encoder {
  status = "okay";
};
